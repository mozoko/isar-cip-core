## Kconfig
```kconfig
#
# CIP Core, generic profile
#
# Copyright (c) Siemens AG, 2021-2025
#
# Authors:
#  Jan Kiszka <jan.kiszka@siemens.com>
#
# SPDX-License-Identifier: MIT
#

mainmenu "Isar core layer of the Civil Infrastructure Platform project"

config KAS_INCLUDE_MAIN
	string
	default "kas-cip.yml"

config KAS_BUILD_SYSTEM
	string
	default "isar-privileged"

config ARCH_AMD64
	bool

config ARCH_ARM64
	bool

config ARCH_ARM
	bool

config ARCH_RISCV64
	bool

config HAS_SWUPDATE
	bool

config HAS_EFIVARS
	bool

config HAS_OPTEE
	bool

config HAS_SECURE_BOOT
	bool

config HAS_DISK_ENCRYPTION
	bool

choice
	prompt "Target board"
	default TARGET_QEMU_AMD64

config TARGET_QEMU_AMD64
	bool "QEMU AMD64 (x86-64)"
	select ARCH_AMD64
	select HAS_SWUPDATE
	select HAS_EFIVARS
	select HAS_SECURE_BOOT
	select HAS_DISK_ENCRYPTION

config TARGET_X86_UEFI
	bool "Generic x86 machine booting via UEFI"
	select ARCH_AMD64
	select HAS_SWUPDATE
	select HAS_EFIVARS
	select HAS_SECURE_BOOT
	select HAS_DISK_ENCRYPTION

config TARGET_QEMU_ARM64
	bool "QEMU ARM64 (aarch64)"
	select ARCH_ARM64
	select HAS_SWUPDATE
	select HAS_OPTEE if KERNEL_6_12
	select HAS_SECURE_BOOT
	select HAS_DISK_ENCRYPTION

config TARGET_HIHOPE_RZG2M
	bool "HopeRun HiHope-RZ/G2M"
	select ARCH_ARM64
	select HAS_SWUPDATE

config TARGET_TI_AM62PX_SK
	bool "Texas Instruments AM62Px SK"
	select ARCH_ARM64
	select HAS_SWUPDATE
	select HAS_SECURE_BOOT
	select HAS_DISK_ENCRYPTION
	select HAS_OPTEE
	select FTPM_STMM

config TARGET_QEMU_ARM
	bool "QEMU ARM (armhf)"
	select ARCH_ARM
	select HAS_SWUPDATE
	select HAS_SECURE_BOOT
	select HAS_DISK_ENCRYPTION

config TARGET_BBB
	bool "BeagleBone Black"
	select ARCH_ARM
	select HAS_SWUPDATE

config TARGET_DE0_NANO_SOC
	bool "DE0-Nano-SoC"
	select ARCH_ARM
	select HAS_SWUPDATE

config TARGET_IWG20D
	bool "iWave Systems RainboW-G20D-Qseven"
	select ARCH_ARM

config TARGET_QEMU_RISCV64
	bool "QEMU RISC-V 64-bit (riscv64)"
	select ARCH_RISCV64
	select HAS_SWUPDATE if KERNEL_6_1 || KERNEL_6_12

config TARGET_BEAGLEV_FIRE
	bool "BeagleV-Fire (riscv64)"
	select ARCH_RISCV64
	select HAS_SWUPDATE

endchoice

config KAS_INCLUDE_BOARD
	string
	default "kas/board/qemu-amd64.yml" if TARGET_QEMU_AMD64
	default "kas/board/x86-uefi.yml" if TARGET_X86_UEFI
	default "kas/board/qemu-arm64.yml" if TARGET_QEMU_ARM64
	default "kas/board/hihope-rzg2m.yml" if TARGET_HIHOPE_RZG2M
	default "kas/board/ti-am62px-sk.yml" if TARGET_TI_AM62PX_SK
	default "kas/board/qemu-arm.yml" if TARGET_QEMU_ARM
	default "kas/board/bbb.yml" if TARGET_BBB
	default "kas/board/de0-nano-soc.yml" if TARGET_DE0_NANO_SOC
	default "kas/board/iwg20m.yml" if TARGET_IWG20D
	default "kas/board/qemu-riscv64.yml" if TARGET_QEMU_RISCV64
	default "kas/board/beaglev-fire.yml" if TARGET_BEAGLEV_FIRE

comment "Kernel options"

choice
	prompt "CIP kernel version"
	default KERNEL_6_12

config KERNEL_4_4
	bool "Kernel 4.4.x-cip"
	depends on !ARCH_ARM64 && !ARCH_RISCV64
	depends on !DEBIAN_TRIXIE

config KERNEL_4_19
	bool "Kernel 4.19.x-cip"
	depends on !ARCH_RISCV64
	depends on !TARGET_TI_AM62PX_SK

config KERNEL_5_10
	bool "Kernel 5.10.x-cip"
	depends on !TARGET_TI_AM62PX_SK && !TARGET_BEAGLEV_FIRE

config KERNEL_6_1
	bool "Kernel 6.1.x-cip"
	depends on !TARGET_TI_AM62PX_SK && !TARGET_BEAGLEV_FIRE

config KERNEL_6_12
	bool "Kernel 6.12.x-cip"
	depends on !TARGET_IWG20D

config NO_KERNEL
	bool "Do not install kernel to image"
	help
	  This does not build the kernel or install it on rootfs.
	  This can be used when creating images for testing kernels that are
	  built separately, e.g. via KernleCI.

endchoice

config KAS_INCLUDE_KERNEL
	string
	default "kas/opt/4.4.yml" if KERNEL_4_4
	default "kas/opt/4.19.yml" if KERNEL_4_19
	default "kas/opt/5.10.yml" if KERNEL_5_10
	default "kas/opt/6.1.yml" if KERNEL_6_1
	default "kas/opt/6.12.yml" if KERNEL_6_12
	default "kas/opt/no_kernel.yml" if NO_KERNEL

config KERNEL_HEAD
	bool "Head of selected CIP kernel branch"
	help
	  Build head of the git branch that corresponds to the selected CIP
	  kernel. May point to an unreleased state.

config KAS_INCLUDE_KERNEL_HEAD
	string
	default "kas/opt/kernel-head.yml"
	depends on KERNEL_HEAD

config KERNEL_RT
	bool "Real-time CIP kernel"
	depends on !ARCH_RISCV64 || KERNEL_6_12

config KAS_INCLUDE_KERNEL_RT
	string
	default "kas/opt/rt.yml"
	depends on KERNEL_RT

if HAS_OPTEE

comment "Firmware options"

config FTPM_STMM
	bool "Use Firmware TPM and rewritable UEFI key storage"
	depends on IMAGE_SWUPDATE
	depends on !DEBIAN_BUSTER

config KAS_INCLUDE_FTPM_STMM
	string
	default "kas/opt/ftpm-stmm.yml"
	depends on FTPM_STMM

endif

comment "Debian distribution options"

choice
	prompt "Debian Release"
	default DEBIAN_TRIXIE

config DEBIAN_BUSTER
	bool "buster (10)"
	depends on !ARCH_RISCV64

config DEBIAN_BULLSEYE
	bool "bullseye (11)"
	depends on !ARCH_RISCV64

config DEBIAN_BOOKWORM
	bool "bookworm (12)"
	depends on !ARCH_RISCV64

config DEBIAN_TRIXIE
	bool "trixie (13)"

config DEBIAN_SID
	bool "Sid (Unstable)"

endchoice

config KAS_INCLUDE_DEBIAN
	string
	default "kas/opt/buster.yml" if DEBIAN_BUSTER
	default "kas/opt/bullseye.yml" if DEBIAN_BULLSEYE
	default "kas/opt/bookworm.yml" if DEBIAN_BOOKWORM
	default "kas/opt/trixie.yml" if DEBIAN_TRIXIE
	default "kas/opt/sid.yml" if DEBIAN_SID

comment "Image features"

config EXPAND_ON_FIRST_BOOT
	bool "Grow last partition to full medium during first boot"

config KAS_INCLUDE_EXPAND_ON_FIRST_BOOT
	string
	default "kas/opt/expand-on-first-boot.yml"
	depends on EXPAND_ON_FIRST_BOOT

config IMAGE_TESTING
	bool "Test extensions"

config KAS_INCLUDE_TESTING
	string
	default "kas/opt/test.yml" if IMAGE_TESTING

if !KERNEL_4_4 && !KERNEL_4_19 && !NO_KERNEL

config IMAGE_SECURITY
	bool "Security extensions"
	select IMAGE_SWUPDATE
	select IMAGE_SECURE_BOOT
	select IMAGE_DATA_ENCRYPTION
	depends on HAS_SWUPDATE && HAS_SECURE_BOOT && HAS_DISK_ENCRYPTION
	help
	  This enables security, encryption, secureboot and swupdate for IEC 62443-4-2.

config KAS_INCLUDE_SECURITY
	string
	default "kas/opt/security.yml" if IMAGE_SECURITY

config IMAGE_SWUPDATE
	bool "SWUpdate support for root partition"
	depends on HAS_SWUPDATE

if IMAGE_SWUPDATE

config WFX_URL
	string "WFX backend URL"
	default ""
	help
	  URL of the wfx backend for software updates. An empty string here implies wfx support is disabled.
	  See ./doc/README.swupdate.md for more about wfx support for updates.

choice
	prompt "Update type"

config IMAGE_COMPLETE_SWUPDATE
	bool "Complete Update"

config IMAGE_DELTA_SWUPDATE
	bool "Delta Update"

endchoice

choice
	prompt "Read-only rootfs type"

config IMAGE_RO_ROOTFS_SQUASHFS
	bool "Squashfs"

config IMAGE_RO_ROOTFS_EROFS
	bool "EROFS"
	depends on (KERNEL_6_1 || KERNEL_6_12) && !DEBIAN_BUSTER && !DEBIAN_BULLSEYE

endchoice

config KAS_INCLUDE_EROFS
	string
	default "kas/opt/erofs.yml" if IMAGE_RO_ROOTFS_EROFS

config IMAGE_SECURE_BOOT
	bool "Secure boot support"
	depends on HAS_SECURE_BOOT

config KAS_INCLUDE_SWUPDATE_SECBOOT
	string
	default "kas/opt/ebg-swu.yml" if IMAGE_SWUPDATE && !IMAGE_SECURE_BOOT
	default "kas/opt/ebg-secure-boot-snakeoil.yml" if IMAGE_SECURE_BOOT

config KAS_INCLUDE_DELTA_UPDATE
	string
	default "kas/opt/delta-update.yml" if IMAGE_DELTA_SWUPDATE

config IMAGE_DATA_ENCRYPTION
	bool "Encrypt data partitions on first boot"
	depends on HAS_DISK_ENCRYPTION
	help
	  This enables LUKS encryption for the partitions /var and /home.

config IMAGE_FULL_ENCRYPTION
	bool "Encrypt rootfs and data partitions"
	depends on HAS_DISK_ENCRYPTION
	select IMAGE_DATA_ENCRYPTION
	help
	  This enables LUKS encryption for all non-boot partitions on first boot.
	  If the partitions contain secrets the first boot must occur in a secure
	  location.

config SEPARATE_HOME_PARTITION
	bool "Separate Home Partition"
	help
	  This adds a separate home partition to the build image instead of moving
	  home to the var partition.

config FACTORY_RESET
	bool "Enable factory reset"
	depends on IMAGE_SWUPDATE && (HAS_EFIVARS || !(IMAGE_FULL_ENCRYPTION || IMAGE_DATA_ENCRYPTION))
	help
	  This adds the necessary packages to request and execute a factory
	  reset of the persistent partition. See also ./doc/README.factory-reset.md.

config KAS_INCLUDE_DATA_ENCRYPTION
	string
	default "kas/opt/encrypt-data.yml" if IMAGE_DATA_ENCRYPTION

config KAS_INCLUDE_FULL_ENCRYPTION
	string
	default "kas/opt/encrypt-all.yml" if IMAGE_FULL_ENCRYPTION

config KAS_INCLUDE_SEPARATE_HOME_PARTITION
	string
	default "kas/opt/separate-home-partition.yml" if SEPARATE_HOME_PARTITION

config KAS_INCLUDE_FACTORY_RESET
	string
	default "kas/opt/factory-reset.yml" if FACTORY_RESET

config WDOG_TIMEOUT
	int "EFI Boot Guard watchdog timeout in seconds"
	default 60
	range 0 65535
	depends on TARGET_QEMU_AMD64 || TARGET_X86_UEFI
	help
	  Timeout in seconds that EFI Boot Guard should set during boot. It
	  needs to be large enough so that systemd can take over the watchdog,
	  continuing to drive it via Linux.

	  Set to 0 for disabling the watchdog in case hardware lacks support.

endif

endif

config IMAGE_TAR_FORMAT
	bool "Separate artifacts for NFS boot"
	depends on !IMAGE_SWUPDATE

config KAS_INCLUDE_TAR_FORMAT
	string
	default "kas/opt/targz.yml" if IMAGE_TAR_FORMAT
```

## conf/distro/cip-core-forky.conf
```bitbake
#
# CIP Core, generic profile
#
# Copyright (c) Toshiba Corporation, 2026
#
# Authors:
#  Shivanand Kunijadar <Shivanand.Kunijadar@toshiba-tsip.com>
#
# SPDX-License-Identifier: MIT
#

require conf/distro/debian-forky.conf
require cip-core-common.inc
```

## conf/distro/cip-core-trixie.conf
```bitbake
#
# CIP Core, generic profile
#
# Copyright (c) Siemens AG, 2024-2025
#
# Authors:
#  Cedric Hombourger <cedric.hombourger@siemens.com>
#
# SPDX-License-Identifier: MIT
#

require conf/distro/debian-trixie.conf
require cip-core-common.inc

PREFERRED_VERSION_linux-cip ?= "6.12.%"
PREFERRED_VERSION_linux-cip-rt ?= "6.12.%"

DISTRO_APT_SOURCES:append:wfx-onboard = " conf/distro/debian-trixie-backports.list"
DISTRO_APT_PREFERENCES:append:wfx-onboard = " conf/distro/preferences.trixie-backports.conf"
```

## conf/layer.conf
```bitbake
#
# CIP Core, generic profile
#
# Copyright (c) Siemens AG, 2019-2025
#
# Authors:
#  Jan Kiszka <jan.kiszka@siemens.com>
#
# SPDX-License-Identifier: MIT
#

BBPATH .= ":${LAYERDIR}"

BBFILES += "${LAYERDIR}/recipes-*/*/*.bb \
        ${LAYERDIR}/recipes-*/*/*.bbappend"

BBFILE_COLLECTIONS += "cip-core"
BBFILE_PATTERN_cip-core = "^${LAYERDIR}/"
BBFILE_PRIORITY_cip-core = "6"

LAYERSERIES_COMPAT_cip-core = "next"

LAYERDIR_cip-core = "${LAYERDIR}"
LAYERDIR_cip-core[vardepvalue] = "isar-cip-core"

CIP_CIS_HARDENING_CONFIG ??= "${DISTRO}-hardening.config.json"
CIP_CIS_HARDENING_KCONFIG ??= "${DISTRO}-hardening.kernel.cfg"
CIP_CIS_HARDENING_REPORT ??= "${DISTRO}-hardening-kernel-${KERNEL_NAME_PROVIDED}-report.json"

IMAGE_CLASSES += "squashfs erofs verity swupdate delta-update qemu-emmc"
```

## conf/machine/bbb.conf
```bitbake
#
# CIP Core, generic profile
#
# Copyright (c) Siemens AG, 2019-2025
#
# SPDX-License-Identifier: MIT
#

DISTRO_ARCH = "armhf"
DTB_FILES = "am335x-boneblack.dtb"

IMAGE_FSTYPES ?= "wic"
IMAGER_INSTALL:wic += "u-boot-bbb ${SYSTEMD_BOOTLOADER_INSTALL}"
IMAGER_BUILD_DEPS += "u-boot-bbb"

USE_CIP_KERNEL_CONFIG = "1"
KERNEL_DEFCONFIG = "cip-kernel-config/${KERNEL_DEFCONFIG_VERSION}/arm/cip_merged_defconfig"

# for SWUpdate setups: watchdog is configured in U-Boot
WDOG_TIMEOUT = "0"
```

## conf/machine/beaglev-fire.conf
```bitbake
#
# CIP Core, generic profile
#
# Copyright (c) Siemens AG, 2025
#
# Authors:
#  Jan Kiszka <jan.kiszka@siemens.com>
#
# SPDX-License-Identifier: MIT
#

DISTRO_ARCH = "riscv64"

IMAGE_FSTYPES ?= "wic"

IMAGER_INSTALL:wic += "${SYSTEMD_BOOTLOADER_INSTALL} u-boot-beaglev-fire"
IMAGER_BUILD_DEPS += "u-boot-beaglev-fire"

USE_CIP_KERNEL_CONFIG = "1"
KERNEL_DEFCONFIG = "cip-kernel-config/${KERNEL_DEFCONFIG_VERSION}/${KERNEL_ARCH}/beaglev-fire_defconfig"

WDOG_TIMEOUT = "0"
```

## conf/machine/de0-nano-soc.conf
```bitbake
#
# CIP Core, generic profile
#
# Copyright (c) Siemens AG, 2025
#
# SPDX-License-Identifier: MIT
#

DISTRO_ARCH = "armhf"
DTB_FILES = "socfpga_cyclone5_de0_nano_soc.dtb"

IMAGE_FSTYPES ?= "wic"
IMAGER_INSTALL:wic += "u-boot-de0-nano-soc ${SYSTEMD_BOOTLOADER_INSTALL}"
IMAGER_BUILD_DEPS += "u-boot-de0-nano-soc"

USE_CIP_KERNEL_CONFIG = "1"

# for SWUpdate setups: watchdog is configured in U-Boot
WDOG_TIMEOUT = "0"
```

## conf/machine/qemu-amd64.conf
```bitbake
#
# CIP Core, generic profile
#
# Copyright (c) Siemens AG, 2019-2024
#
# SPDX-License-Identifier: MIT
#

DISTRO_ARCH = "amd64"

IMAGE_FSTYPES ?= "ext4"
USE_CIP_KERNEL_CONFIG = "1"

PREFERRED_PROVIDER_factory-reset-helper:swupdate = "factory-reset-helper-efi"
```

## conf/machine/rzt2h-evk.conf
```bitbake
#
# CIP Core, generic profile
#
# Copyright (c) 2026 Renesas Electronics Corporation
#
# Authors:
#  Hung Tran <hung.tran.jy@renesas.com>
#
# SPDX-License-Identifier: MIT
#

DISTRO_ARCH = "arm64"

IMAGE_FSTYPES ?= "wic"

USE_CIP_KERNEL_CONFIG = "1"
DTB_FILES = "r9a09g077m44-rzt2h-evk.dtb"
IMAGE_BOOT_FILES = "${KERNEL_IMAGE} ${DTB_FILES}"
```

## conf/machine/ti-am62px-sk.conf
```bitbake
#
# Copyright (c) Texas Instruments Incorporated, 2025
#
# Authors:
#  Sai Sree Kartheek Adivi <s-adivi@ti.com>
#
# SPDX-License-Identifier: MIT
#

DISTRO_ARCH = "arm64"
DTB_FILES = "k3-am62p5-sk.dtb"

IMAGE_FSTYPES ?= "wic"

IMAGER_INSTALL:wic += "${SYSTEMD_BOOTLOADER_INSTALL} u-boot-ti-am62px-sk"
IMAGER_BUILD_DEPS += "u-boot-ti-am62px-sk"

IMAGE_PREINSTALL += "firmware-ti-connectivity"

IMAGE_BOOT_FILES = " \
    /usr/lib/u-boot/${MACHINE}/u-boot.img;u-boot.img \
    /usr/lib/u-boot/${MACHINE}/tispl.bin;tispl.bin \
    /usr/lib/u-boot/${MACHINE}/tiboot3-am62px-hs-fs-evm.bin;tiboot3.bin"

USE_CIP_KERNEL_CONFIG = "1"
KERNEL_DEFCONFIG = "cip-kernel-config/${KERNEL_DEFCONFIG_VERSION}/arm64/cip_merged_defconfig"

WDOG_TIMEOUT = "0"
```

## conf/machine/x86-uefi.conf
```bitbake
#
# CIP Core, generic profile
#
# Copyright (c) Siemens AG, 2019-2024
#
# SPDX-License-Identifier: MIT
#

DISTRO_ARCH = "amd64"

IMAGE_FSTYPES ?= "wic"
WKS_FILE ?= "x86_64-generic.wks"
IMAGER_INSTALL:wic += "${GRUB_BOOTLOADER_INSTALL}"
USE_CIP_KERNEL_CONFIG = "1"

PREFERRED_PROVIDER_factory-reset-helper = "factory-reset-helper-efi"
```

## wic/beaglev-fire.wks
```
#
# CIP Core, generic profile
#
# Copyright (c) Siemens, 2025
#
# SPDX-License-Identifier: MIT
#

part --source rawcopy --sourceparams "file=/usr/lib/u-boot/beaglev-fire/payload.bin" --part-type 21686148-6449-6E6F-744E-656564454649

part /boot --source bootimg-efi-isar --sourceparams "loader=systemd-boot" --label efi --part-type EF00 --align 1024 --use-uuid
part / --source rootfs --fstype ext4 --mkfs-extraopts "-T default" --label platform --align 1024 --use-uuid --exclude-path boot/

bootloader --ptable gpt --timeout=0 --append "rootwait rw"
```

## wic/de0-nano-soc.wks
```
#
# CIP Core, generic profile
#
# Copyright (c) Siemens AG, 2019-2025
#
# SPDX-License-Identifier: MIT
#

part --source rawcopy --sourceparams "file=/usr/lib/u-boot/de0-nano-soc/u-boot-with-spl.sfp" --align 2 --mbr

part /boot --source bootimg-efi-isar --sourceparams "loader=systemd-boot,dtb=socfpga_cyclone5_de0_nano_soc.dtb" --label efi --part-type EF00 --align 1024 --fsuuid 0x4321dcba --uuid 16d61432-ec24-42fa-a4b8-b2bc20a26f5e --use-uuid
part / --source rootfs --fstype ext4 --mkfs-extraopts "-T default" --label platform --align 1024 --fsuuid 1f55d66a-40d8-11ee-be56-0242ac120002 --uuid 25d57b24-f34d-412e-8c88-28629f23aa0d --use-uuid

bootloader --ptable gpt-hybrid --source "de0-nano-soc-firmware" --timeout=0 --append "rootwait console=ttyO0,115200"
```
