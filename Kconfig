## wic/rzt2h-evk.wks
```
#
# CIP Core, generic profile
#
# Copyright (c) 2026 Renesas Electronics Corporation
#
# Authors:
#  Hung Tran <hung.tran.jy@renesas.com>
#
# SPDX-License-Identifier: MIT
#

part /boot --source bootimg-partition --ondisk mmcblk0 --fstype vfat --label boot --align 1 --size 32M --extra-space 0 --fsuuid 0x4321dcba --use-uuid

# Rootfs partition
part / --source rootfs --ondisk mmcblk0 --fstype ext4 --label root --align 1024 --size 2G --active --fsuuid 1f55d66a-40d8-11ee-be56-0242ac120002 --use-uuid

bootloader --ptable gpt
```
